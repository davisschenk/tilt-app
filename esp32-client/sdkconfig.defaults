## esp32-client/sdkconfig.defaults
```kconfig
# Rust often needs a bit of an extra main task stack size compared to C (the default is 3K)
CONFIG_ESP_MAIN_TASK_STACK_SIZE=8192

# Increase a bit these stack sizes as they are also a bit too small by default
CONFIG_ESP_SYSTEM_EVENT_TASK_STACK_SIZE=4096
CONFIG_FREERTOS_IDLE_TASK_STACKSIZE=4096

# Default pthread stack size
CONFIG_PTHREAD_TASK_STACK_SIZE_DEFAULT=4096

# Flash size: 4MB (required for custom partition table totaling ~3.2MB)
CONFIG_ESPTOOLPY_FLASHSIZE_4MB=y

# Enable Boya flash chip driver — board uses Boya (BY25Q) flash; without this
# esp-idf falls back to the generic driver and logs a warning at every boot.
CONFIG_SPI_FLASH_SUPPORT_BOYA_CHIP=y

# Suppress old I2C driver deprecation warning — a NimBLE internal component
# initializes the legacy i2c driver; we don't use I2C directly.
CONFIG_I2C_SUPPRESS_DEPRECATE_WARN=y

# Custom partition table for dual OTA slots
CONFIG_PARTITION_TABLE_CUSTOM=y
CONFIG_PARTITION_TABLE_CUSTOM_FILENAME="partitions.csv"
CONFIG_PARTITION_TABLE_OFFSET=0x8000

# Enable Bluetooth
CONFIG_BT_ENABLED=y
CONFIG_BT_BLUEDROID_ENABLED=n
CONFIG_BT_NIMBLE_ENABLED=y
# Increase NimBLE host task stack (default 4096 is too small with Rust closures)
CONFIG_BT_NIMBLE_HOST_TASK_STACK_SIZE=8192

# Enable WiFi
CONFIG_ESP_WIFI_ENABLED=y

# Reduce log verbosity — suppresses some noisy driver output
CONFIG_LOG_DEFAULT_LEVEL_INFO=y
CONFIG_LOG_MAXIMUM_LEVEL_INFO=y

# Task Watchdog Timer (TWDT) — auto-reboot if main loop hangs
CONFIG_ESP_TASK_WDT_EN=y
CONFIG_ESP_TASK_WDT_PANIC=y
CONFIG_ESP_TASK_WDT_TIMEOUT_S=120
# Disable TWDT on idle tasks — block_on() in the BLE scan starves the idle
# task scheduler, triggering a false WDT. We manually subscribe the main task
# via esp_task_wdt_add() and feed it between scan chunks instead.
CONFIG_ESP_TASK_WDT_CHECK_IDLE_TASK_CPU0=n
CONFIG_ESP_TASK_WDT_CHECK_IDLE_TASK_CPU1=n
```
